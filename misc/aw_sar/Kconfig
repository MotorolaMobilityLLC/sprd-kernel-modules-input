## misc/aw_sar/Kconfig
```kconfig
menu "aw96308 driver"

config AW96308
	tristate "aw96308 driver"
	help
	  aw96308 driver

endmenu
```

## misc/sx9375/Kconfig
```kconfig
menu "sx9375 driver"

config SX9375
	tristate "sx9375 driver"
	help
	  sx9375 driver

endmenu
```
